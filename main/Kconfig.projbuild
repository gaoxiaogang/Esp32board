## main/Kconfig.projbuild
```kconfig
menu "Xiaozhi Assistant"

    config OTA_VERSION_URL
        string "OTA Version URL"
        default "https://api.tenclass.net/xiaozhi/ota/"
        help
            The application will access this URL to check for updates.
    
    
    choice
        prompt "语言选择"
        default LANGUAGE_EN_US
        help
            Select device display language
    
        config LANGUAGE_ZH_CN
            bool "Chinese"
        config LANGUAGE_EN_US
            bool "English"
    endchoice
    
    
    choice CONNECTION_TYPE
        prompt "Connection Type"
        default CONNECTION_TYPE_MQTT_UDP
        help
            网络数据传输协议
        config CONNECTION_TYPE_MQTT_UDP
            bool "MQTT + UDP"
        config CONNECTION_TYPE_WEBSOCKET
            bool "Websocket"
    endchoice
    
    config WEBSOCKET_URL
        depends on CONNECTION_TYPE_WEBSOCKET
        string "Websocket URL"
        default "wss://api.tenclass.net/xiaozhi/v1/"
        help
            Communication with the server through websocket after wake up.
    
    config WEBSOCKET_ACCESS_TOKEN
        depends on CONNECTION_TYPE_WEBSOCKET
        string "Websocket Access Token"
        default "test-token"
        help
            Access token for websocket communication.
    
    choice BOARD_TYPE
        prompt "Board Type"
        default BOARD_TYPE_BREAD_COMPACT_ESP32
        help
            Board type. 开发板类型
        config BOARD_TYPE_BREAD_COMPACT_WIFI
            bool "面包板新版接线（WiFi）-ESP32S3"
        config BOARD_TYPE_BREAD_COMPACT_ESP32
            bool "面包板（WiFi） ESP32 DevKit"
    endchoice

    choice DISPLAY_OLED_TYPE
        depends on BOARD_TYPE_BREAD_COMPACT_WIFI || BOARD_TYPE_BREAD_COMPACT_ESP32
        prompt "OLED Type"
        default OLED_SSD1306_128X32
        help
            OLED 屏幕类型选择
        config OLED_SSD1306_128X32
            bool "SSD1306, 分辨率128*32"
        config OLED_SSD1306_128X64
            bool "SSD1306, 分辨率128*64"
    endchoice
    
    config USE_AUDIO_PROCESSOR
        bool "启用音频降噪、增益处理"
        default y
        depends on IDF_TARGET_ESP32S3 && USE_AFE
        help
            需要 ESP32 S3 与 AFE 支持
    
    config USE_WAKE_WORD_DETECT
        bool "启用唤醒词检测"
        default y
        depends on IDF_TARGET_ESP32S3 && USE_AFE
        help
            需要 ESP32 S3 与 AFE 支持
    endmenu
    
```
